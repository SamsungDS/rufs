## drivers/rufs/Kconfig
```kconfig
# SPDX-License-Identifier: GPL-2.0-only

menuconfig RUFS
	tristate "Rust UFS host controller driver"
	depends on RUST
	help
	  Enables the Rust UFS host controller driver (experimental).

if RUFS

config RUFS_PCI
	bool "PCI bus frontend"
	depends on PCI
	default y if PCI
	help
	  Build the PCI frontend for QEMU and PCI-attached UFS controllers.

config RUFS_QCOM
	bool "Qualcomm platform frontend"
	depends on OF
	depends on COMMON_CLK
	depends on GENERIC_PHY
	depends on GPIOLIB
	depends on INTERCONNECT
	depends on PM_OPP
	depends on RESET_CONTROLLER
	depends on ARCH_QCOM || COMPILE_TEST
	help
	  Build the Qualcomm platform frontend. The frontend maps the UFSHCI
	  resource and configures the clocks, PHY, reset and interconnect paths
	  needed by supported Qualcomm UFS controllers.

endif
```
